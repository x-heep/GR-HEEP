/dts-v1/;
/plugin/;

/ {
    fragment@0 {
        target-path = "/amba_pl@0";

        __overlay__ {
            serial@a4040000 {
                compatible = "xlnx,xps-uartlite-1.00.a";

                reg = <0x0 0xa4040000 0x0 0x10000>;

                interrupt-parent = <&gic>;
                interrupts = <0 92 4>;

                current-speed = <9600>;

                xlnx,data-bits = <8>;
                xlnx,use-parity = <0>;
                xlnx,odd-parity = <0>;

                status = "okay";
            };
        };
    };
};
